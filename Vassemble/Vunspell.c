/*--------------------------------------------------------------------------------------*/
/*                                                                                      */
/*  File:       Vunspell.c                                                              */
/*                                                                                      */
/*  Contains:   The main entry point and support routines for the Vunspell module.      */
/*                                                                                      */
/*  Written by: Norman Jaffe                                                            */
/*                                                                                      */
/*  Copyright:  (c) 2003 by T. H. Schiphorst, N. Jaffe, K. Gregory and G. I. Gregson.   */
/*                                                                                      */
/*              All rights reserved. Redistribution and use in source and binary forms, */
/*              with or without modification, are permitted provided that the following */
/*              conditions are met:                                                     */
/*                * Redistributions of source code must retain the above copyright      */
/*                  notice, this list of conditions and the following disclaimer.       */
/*                * Redistributions in binary form must reproduce the above copyright   */
/*                  notice, this list of conditions and the following disclaimer in the */
/*                  documentation and/or other materials provided with the              */
/*                  distribution.                                                       */
/*                * Neither the name of the copyright holders nor the names of its      */
/*                  contributors may be used to endorse or promote products derived     */
/*                  from this software without specific prior written permission.       */
/*                                                                                      */
/*              THIS SOFTWARE IS PROVIDED BY THE COPYRIGHT HOLDERS AND CONTRIBUTORS     */
/*              "AS IS" AND ANY EXPRESS OR IMPLIED WARRANTIES, INCLUDING, BUT NOT       */
/*              LIMITED TO, THE IMPLIED WARRANTIES OF MERCHANTABILITY AND FITNESS FOR A */
/*              PARTICULAR PURPOSE ARE DISCLAIMED. IN NO EVENT SHALL THE COPYRIGHT      */
/*              OWNER OR CONTRIBUTORS BE LIABLE FOR ANY DIRECT, INDIRECT, INCIDENTAL,   */
/*              SPECIAL, EXEMPLARY, OR CONSEQUENTIAL DAMAGES (INCLUDING, BUT NOT        */
/*              LIMITED TO, PROCUREMENT OF SUBSTITUTE GOODS OR SERVICES; LOSS OF USE,   */
/*              DATA, OR PROFITS; OR BUSINESS INTERRUPTION) HOWEVER CAUSED AND ON ANY   */
/*              THEORY OF LIABILITY, WHETHER IN CONTRACT, STRICT LIABILITY, OR TORT     */
/*              (INCLUDING NEGLIGENCE OR OTHERWISE) ARISING IN ANY WAY OUT OF THE USE   */
/*              OF THIS SOFTWARE, EVEN IF ADVISED OF THE POSSIBILITY OF SUCH DAMAGE.    */
/*                                                                                      */
/*  Created:    2003/06/17                                                              */
/*                                                                                      */
/*--------------------------------------------------------------------------------------*/

#define IS_MAIN /* */
#include "Vunspell.h"
#include "displayAboutBox.h"
#include "loadAboutBoxData.h"
#include "loadOtherSegments.h"
#include "reportAnything.h"
#include "reportVersion.h"

/* Forward references: */
Pvoid VunspellCreate
  (long separator1,
   long separator2,
   long separator3,
   long separator4,
   long separator5);

Pvoid VunspellFree
  (VObjectPtr xx);

/*------------------------------------ main ---*/
void main
  (Pfptr ff)
{
  EnterCodeResource();
  PrepareCallback();
  FNS = ff;   /* Connect up the function macros. */
  /* Allocate class memory and set up class. */
  setup(reinterpret_cast<t_messlist**>(&gClass), reinterpret_cast<method>(VunspellCreate),
        reinterpret_cast<method>(VunspellFree), short(sizeof(VObjectData)),
        reinterpret_cast<method>(0L), A_LONG, A_DEFLONG, A_DEFLONG, A_DEFLONG, A_DEFLONG,
        A_NOTHING);
  addmess(reinterpret_cast<method>(cmd_Anything), "anything", A_GIMME, A_NOTHING);
  addmess(reinterpret_cast<method>(cmd_Assist), "assist", A_CANT, A_NOTHING);
  addbang(reinterpret_cast<method>(cmd_Bang));
  addmess(reinterpret_cast<method>(cmd_Info), "info", A_CANT, A_NOTHING);
  addint(reinterpret_cast<method>(cmd_Int));
  addmess(reinterpret_cast<method>(cmd_List), "list", A_GIMME, A_NOTHING);
  /* Add object class to New Object List */
  finder_addclass("Lists", OUR_NAME);
  /* Make sure that our string list resource is present */
  rescopy('STR#', OUR_RES_NUMB);
  loadAboutBoxData();
  gVersionNumber = reportVersion(OUR_NAME);
  loadOtherSegments();
  ExitCodeResource();
} /* main */

/*------------------------------------ VunspellCreate ---*/
Pvoid VunspellCreate
  (long separator1,
   long separator2,
   long separator3,
   long separator4,
   long separator5)
{
  VObjectPtr xx;

  EnterCallback();
  LOG_ENTER()
  xx = static_cast<VObjectPtr>(newobject(gClass));
  if (xx)
  {
  	if (setupSeparators(xx, separator1, separator2, separator3, separator4,
  											separator5))
  	{
	    xx->fPreviousList = NULL_PTR;
	    xx->fPreviousLength = 0;
	    xx->fChunkList = xx->fLastChunk = NULL_PTR;
	    xx->fAssembled = false;
	    xx->fBangOut = static_cast<POutlet>(bangout(xx));
	    xx->fResultOut = static_cast<POutlet>(outlet_new(xx, NULL_PTR));
	    if (! (xx->fBangOut && xx->fResultOut))
	    {
	      LOG_ERROR_1(OUTPUT_PREFIX "unable to create port for object")
	      freeobject(reinterpret_cast<PObject>(xx));
	      xx = NULL_PTR;
	    }
  	}
  	else
  	{
      LOG_ERROR_1(OUTPUT_PREFIX "bad separator list")
      freeobject(reinterpret_cast<PObject>(xx));
      xx = NULL_PTR;
  	}
  }
  ExitCodeResource();
  return xx;
} /* VunspellCreate */

/*------------------------------------ VunspellFree ---*/
Pvoid VunspellFree
  (VObjectPtr xx)
{
  EnterCallback();
  if (xx)
    clearPrevious(xx);
  LOG_EXIT()
  ExitMaxMessageHandler()
} /* VunspellFree */

/*------------------------------------ processInput ---*/
void processInput
  (VObjectPtr xx,
   const long value)
{
  ChunkPtr  workChunk;
  
  if (xx->fAssembled)
  {
    clearPrevious(xx);
    xx->fAssembled = false;
  }
  if (isSeparator(xx, value))
  {
    if (xx->fPreviousLength)
    {
	    short   	atomCount = 0;
	    PAtombuf	accumulator = static_cast<PAtombuf>(atombuf_new(0, 0));
    	Handle		rawData = newhandle(xx->fPreviousLength);

			if (accumulator && rawData)
			{
        short     offset = 0;
        ChunkPtr  iWalker = xx->fChunkList;
        Pchar			temp = *rawData;
        
        while (iWalker)
        {
          for (short index = 0; index < iWalker->fLastEntry; index++, offset++)
            *(temp + offset) = char(iWalker->fData[index]);
          iWalker = iWalker->fNext;
        }
        atombuf_text(&accumulator, rawData, xx->fPreviousLength);
        if (accumulator->a_argc)
        	genericListOutput(xx->fResultOut, short(accumulator->a_argc),
        										accumulator->a_argv);
			}
			if (rawData)
				disposhandle(rawData);
    	if (accumulator)
    		atombuf_free(accumulator);
    	xx->fPreviousLength = 0;
      xx->fAssembled = true;
    }
    else
      outlet_bang(xx->fBangOut);
  }
  else if (xx->fLastChunk)
  {
    workChunk = xx->fLastChunk;
    short index = workChunk->fLastEntry;
    
    if (index == CHUNK_SIZE)
    {
      ChunkPtr  newChunk = GETBYTES(1, ChunkData);
      
      if (newChunk)
      {
        workChunk->fNext = xx->fLastChunk = newChunk;
        newChunk->fNext = NULL_PTR;
        newChunk->fLastEntry = 1;
        newChunk->fData[0] = value;
      }
    }
    else
    {
      workChunk->fData[index] = value;
      workChunk->fLastEntry = short(index + 1);
    } 
    xx->fPreviousLength++;
  }
  else
  {
    workChunk = GETBYTES(1, ChunkData);
    if (workChunk)
    {
      xx->fChunkList = xx->fLastChunk = workChunk;
      workChunk->fNext = NULL_PTR;
      workChunk->fLastEntry = xx->fPreviousLength = 1;
      workChunk->fData[0] = value;
    }  
  }
} /* processInput */
 
StandardAnythingRoutine(VObjectPtr)
StandardInfoRoutine(VObjectPtr)