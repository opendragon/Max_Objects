/*--------------------------------------------------------------------------------------*/
/*																						*/
/*	File:		Common Info Code.inc													*/
/*																						*/
/*	Contains:	The routine cmd_Info().													*/
/*																						*/
/*	Written by:	Norman Jaffe															*/
/*																						*/
/*	Copyright:	© 2000 by K. Gregory, G. I. Gregson, N. Jaffe and T. H. Schiphorst.		*/
/*				All rights reserved. This software and documentation may be distributed	*/
/*				for non-commercial use only. Any commercial use, without the written	*/
/*				permission of N. Jaffe and T. H. Schiphorst, is strictly prohibited.	*/
/*																						*/
/*	Change History (most recent first):													*/
/*																						*/
/*	Version	Author	Date		Status													*/
/*	1.0.0	NJ		2000/06/13	Created													*/
/*																						*/
/*	To Do:																				*/
/*																						*/
/*--------------------------------------------------------------------------------------*/

{
	short			itemHit;
	DialogPtr		dp;
	DialogItemType	itemType;
	Handle			item;
	Rect			itemBox;
	PenState		ps;

	dp = GetNewDialog(OUR_RES_NUMB, 0L, (WindowPtr) (-1L));
	/* Highlight default button */	
	SetPort(dp);
	GetDialogItem(dp, 1, &itemType, &item, &itemBox);
	GetPenState(&ps);
	PenNormal();
	PenSize(3, 3);
	InsetRect(&itemBox, -4, -4);
	FrameRoundRect(&itemBox, 16, 16);
	SetPenState(&ps);	
	for (;;)
	{
		ModalDialog(0L, &itemHit);
		if (itemHit == 1)
		{
			break;
		}

	}
	DisposeDialog(dp);
}
